## config/west.yml
```yaml
manifest:
  remotes:
    - name: zmkfirmware
      url-base: https://github.com/zmkfirmware
    - name: TahuTech
      url-base: https://github.com/TahuTech
  projects:
    - name: zmk
      remote: TahuTech
      revision: rable
      import: app/west.yml
  self:
    path: config
```
